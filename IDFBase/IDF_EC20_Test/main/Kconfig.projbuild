## IDFBase/IDF_EC20_Test/main/Kconfig.projbuild
```kconfig
menu "EC20 Configuration"
    
    config EC20_ENABLE_GPS
        bool "Enable GPS?"
        default false
        help
            Set true to enable GPS
    
    config EC20_ENABLE_MQTT
        bool "Enable MQTT?"
        default false
        help
            Set true to enable MQTT telemetry
endmenu
```

## IDFBase/IDF_I2C_Test/main/Kconfig.projbuild
```kconfig
menu "Custom I2C Configuration"

    config I2C_0_SDA
        int "I2C 0 SDA Pin"
        range 0 35
        default 21

    config I2C_0_SCL
        int "I2C 0 SDA Pin"
        range 0 35
        default 22
    
    config I2C_0_SPEED
        int "I2C 0 data transfer speed"
        range 0 4000000
        default 100000
endmenu
```

## IDFBase/IDF_Networking_Test/main/Kconfig.projbuild
```kconfig
menu "Websocket Configuration"
    config WS_URI
        string "Websocket URI"
        default "ws://192.168.4.1"
        help
            URI for the websocket to connect to
endmenu
```

## IDFBase/IDF_UART_Test/main/Kconfig.projbuild
```kconfig
menu "UART Configuration"

    config UART_PORT_NUM
        int "UART port number"
        range 0 2
        default 1
        help
            UART communication port number

    config UART_BAUD_RATE
        int "UART communication speed"
        range 1200 115200
        default 115200
        help
            UART communication speed

    config UART_RXD
        int "UART RXD pin number"
        range -1 34
        default 5
        help
            GPIO number for UART RX pin

    config UART_TXD
        int "UART TXD pin number"
        range -1 34
        default 4
        help
            GPIO number for UART TX pin

    config UART_STACK_SIZE
        int "UART echo task stack size"
        range 1024 16384
        default 2048
        help
            Defines stack size for UART. Insufficient stack size can cause crash.

endmenu
```
